## CMakeLists.txt
```
# SPDX-License-Identifier: Apache-2.0

cmake_minimum_required(VERSION 3.20.0)
find_package(Zephyr REQUIRED HINTS $ENV{ZEPHYR_BASE})
project(bap_broadcast_assistant)

target_sources(app PRIVATE
  src/main.c
  src/metadata.c
  src/gatt_link.c
  src/sink_link.c
)

zephyr_library_include_directories(${ZEPHYR_BASE}/samples/bluetooth)
```

## prj.conf
```kconfig
CONFIG_BT=y
CONFIG_LOG=y
CONFIG_BT_CENTRAL=y
CONFIG_BT_GATT_CLIENT=y
CONFIG_BT_GATT_AUTO_DISCOVER_CCC=y
CONFIG_BT_GATT_AUTO_UPDATE_MTU=y
CONFIG_UTF8=y
CONFIG_BT_AUDIO=y
CONFIG_BT_SMP=y
CONFIG_BT_BUF_ACL_RX_SIZE=255
CONFIG_BT_BUF_ACL_TX_SIZE=251

CONFIG_BT_EXT_ADV=y
CONFIG_BT_PER_ADV_SYNC=y
CONFIG_BT_BAP_BASS_MAX_SUBGROUPS=2
CONFIG_BT_ISO_SYNC_RECEIVER=y
CONFIG_BT_BAP_BROADCAST_ASSISTANT=y
CONFIG_BT_AUDIO_CODEC_CFG_MAX_METADATA_SIZE=255
CONFIG_BT_PER_ADV_SYNC_BUF_SIZE=255

CONFIG_SETTINGS=y
CONFIG_BT_SETTINGS=y
CONFIG_FLASH=y
CONFIG_FLASH_MAP=y
CONFIG_NVS=y
CONFIG_BT_LOG_LEVEL_WRN=y

# Convert board to also a server
CONFIG_BT_PERIPHERAL=y
CONFIG_BT_DEVICE_NAME="Auracast AC Assistant"
```

## src/main.c
```c
/*
 * Copyright (c) 2024 Demant A/S
 * Copyright (c) 2024-2025 Nordic Semiconductor ASA
 *
 * SPDX-License-Identifier: Apache-2.0
 */

#include <errno.h>
#include <stdbool.h>
#include <stddef.h>
#include <stdint.h>
#include <string.h>
#include <strings.h>

#include <zephyr/autoconf.h>
#include <zephyr/bluetooth/addr.h>
#include <zephyr/bluetooth/assigned_numbers.h>
#include <zephyr/bluetooth/audio/audio.h>
#include <zephyr/bluetooth/audio/bap.h>
#include <zephyr/bluetooth/bluetooth.h>
#include <zephyr/bluetooth/conn.h>
#include <zephyr/bluetooth/gap.h>
#include <zephyr/bluetooth/hci.h>
#include <zephyr/bluetooth/hci_types.h>
#include <zephyr/bluetooth/iso.h>
#include <zephyr/bluetooth/uuid.h>
#include <zephyr/kernel.h>
#include <zephyr/net_buf.h>
#include <zephyr/sys/__assert.h>
#include <zephyr/sys/byteorder.h>
#include <zephyr/sys/printk.h>
#include <zephyr/sys/util.h>
#include <zephyr/types.h>
#include <zephyr/settings/settings.h>

#include "metadata.h"
#include "gatt_link.h"
#include "sink_link.h"

// Definitions
#define NAME_LEN 30 // 30 bytes, size of name buffers
#define SEM_TIMEOUT K_SECONDS(10) // Semaphore for threads
#define BROADCAST_CODE "AURA86DEMO2026" // Shared with all 4 stops

// Temp. struct for one advertisement
struct scan_recv_info {
	struct metadata metadata;
	char bt_name[NAME_LEN]; // Device local name
	char broadcast_name[NAME_LEN]; // Auracast name 
	uint32_t broadcast_id; // 24-bit Auracast Broadcast ID
	bool has_metadata;
	bool has_bass; // BASS flag
	bool has_pacs; // PACS flag
};

// Broadcast code
static uint8_t broadcast_code[BT_ISO_BROADCAST_CODE_SIZE];
BUILD_ASSERT(sizeof(BROADCAST_CODE) - 1 <= BT_ISO_BROADCAST_CODE_SIZE, "Broadcast code is too long");

// Link with broadcast sink
static struct bt_conn *broadcast_sink_conn;

// Sink's handle for source - 0 = none active
static uint8_t current_src_id;

// Receive state describing some other source isn't mistaken for ours
static bool expecting_src_id;

// Source scan findings - callbacks fill, main adds to source
static uint8_t remote_recv_state_count; // How many receive states the sink exposes
static uint32_t selected_broadcast_id;
static uint8_t selected_sid;
static uint16_t selected_pa_interval;
static bt_addr_le_t selected_addr;

// True when scanning for a source, false when scanning for a sink
static bool scanning_for_broadcast_source;

// Semaphores for discovery, connection and disconnections
static K_SEM_DEFINE(sem_source_discovered, 0, 1);
static K_SEM_DEFINE(sem_sink_connected, 0, 1);
static K_SEM_DEFINE(sem_sink_disconnected, 0, 1);
static K_SEM_DEFINE(sem_security_updated, 0, 1);
static K_SEM_DEFINE(sem_bass_discovered, 0, 1);
static K_SEM_DEFINE(sem_recv_state_read, 0, 1);
static K_SEM_DEFINE(sem_source_removed, 0, 1);

/**
 * Callback for bt_data_parse. Handles one element from the chain
 * of AD elements.
 * 
 * UUID list: packed array of 2-byte UUIDs. Names only.
 * e.g. 05(length) 03(type) 4F18(BASS) 4418(VCS)
 * 
 * Service data: UUID + bytes
 * e.g. 06(length) 16(type) 5218(UUID 0x1852 (Broadcast Audio Announcement) 63(Broadcast ID) 1D A2
 * 
 * @param data current advertising data element
 * @param user_data caller data e.g. addr of scan_recv_info
 * 
 * @return keeps parsing onto next AD element if true
 */
static bool device_found(struct bt_data *data, void *user_data)
{
	// Cast caller's type
	struct scan_recv_info *sr_info = (struct scan_recv_info *)user_data;
	struct bt_uuid_16 adv_uuid;

	// Branching on the AD type bytes
	switch (data->type) {
	case BT_DATA_MANUFACTURER_DATA:
		// Check: length of metadata
		if (data->data_len < 2 + METADATA_MIN_LEN) {
			return true;
		}

		// Read and compare company ID
		if (sys_get_le16(data->data) != METADATA_COMPANY_ID) {
			return true;
		}

		// Call parser - from after company ID, length excludes company ID
		if(metadata_parse(&data->data[2], data->data_len - 2, &sr_info->metadata)) {
			// Set success flag
			sr_info->has_metadata = true;
		}

		return true;
	case BT_DATA_NAME_SHORTENED: // Truncated device name
	case BT_DATA_NAME_COMPLETE: // Full device name
		// Copy the name, or 29 bytes whichever one is smallest
		memcpy(sr_info->bt_name, data->data, MIN(data->data_len, NAME_LEN - 1));
		return true;
	case BT_DATA_BROADCAST_NAME: // Auracast broadcast name
		// Auracast's own name field
		memcpy(sr_info->broadcast_name, data->data, MIN(data->data_len, NAME_LEN - 1));
		return true;
	case BT_DATA_SVC_DATA16: // Type 0x16: see if element has BASS or PACS
		// UUID needs to be aleast 16-bits
		if (data->data_len < BT_UUID_SIZE_16) {
			return true;
		}

		// Turn the 2 raw bytes to UUID obj
		if (!bt_uuid_create(&adv_uuid.uuid, data->data, BT_UUID_SIZE_16)) {
			return true;
		}

		// Check: element has BASS
		if (bt_uuid_cmp(&adv_uuid.uuid, BT_UUID_BASS) == 0) {
			sr_info->has_bass = true;
			return true;
		}

		// Check: element has PACS
		// TODO: deprecate
		if (bt_uuid_cmp(&adv_uuid.uuid, BT_UUID_PACS) == 0) {
			sr_info->has_pacs = true;
			return true;
		}

		// Check: is it a Broadcast Audio Announcement?
		if (bt_uuid_cmp(&adv_uuid.uuid, BT_UUID_BROADCAST_AUDIO) != 0) {
			return true;
		}

		// Broadcast Audio Announcement carries a 24-bit Broadcast ID
		if (data->data_len < BT_UUID_SIZE_16 + BT_AUDIO_BROADCAST_ID_SIZE) {
			return true;
		}

		sr_info->broadcast_id = sys_get_le24(data->data + BT_UUID_SIZE_16);
		return true;
	case BT_DATA_UUID16_SOME: // Partial/full list of 16-bit service UUIDs
	case BT_DATA_UUID16_ALL: // Type 0x03: see if element has BASS or PACS
		// Odd length = malformed
		if (data->data_len % sizeof(uint16_t) != 0U) {
			printk("UUID16 AD malformed\n");
			return true;
		}

		// 2 bytes at a time
		for (size_t i = 0; i < data->data_len; i += sizeof(uint16_t)) {
			const struct bt_uuid *uuid;
			uint16_t u16;

			memcpy(&u16, &data->data[i], sizeof(u16));
			uuid = BT_UUID_DECLARE_16(sys_le16_to_cpu(u16));

			if (bt_uuid_cmp(uuid, BT_UUID_BASS) == 0) {
				sr_info->has_bass = true;
				continue;
			}

			if (bt_uuid_cmp(uuid, BT_UUID_PACS) == 0) {
				sr_info->has_pacs = true;
				continue;
			}
		}
		return true;
	default:
		return true;
	}
}

/**
 * Zephyr calls when radio picks up an advertisment.
 * 
 * @param info metadata about reception (sender address, RSSI, advertising SID, etc.).
 * Not contents, how to arrived.
 * @param ad Raw advertising payload. A buffer to give to bt_data_parse to walk elements.
 */
static void scan_recv_cb(const struct bt_le_scan_recv_info *info, struct net_buf_simple *ad)
{
	int err;
	struct scan_recv_info sr_info = {0};

	if (scanning_for_broadcast_source) { // Already scanning for source
		// Scan for and select Broadcast Source
		sr_info.broadcast_id = BT_BAP_INVALID_BROADCAST_ID;

		// Only interested in non-connectable periodic advertisers
		if ((info->adv_props & BT_GAP_ADV_PROP_CONNECTABLE) != 0 || info->interval == 0) {
			return;
		}

		// Walk and parse the advertisment, and sr_info stores
		bt_data_parse(ad, device_found, (void *)&sr_info);

		// Check: parsing found a Broadcast Audio Announcement
		if (sr_info.broadcast_id != BT_BAP_INVALID_BROADCAST_ID) {
			// Check: metadata is present in incoming Auracast broadcast
			if (!sr_info.has_metadata) {
				return;
			}

			// Check: advertisement comes from the correct stop with provisioned dongle
			if (sr_info.metadata.stop_index != gatt_link_get_requested_stop_index()) {
				// Abandon the advertisement
				return;
			}

			printk("Broadcast Source Found:\n");
			printk("BT Name: %s\n", sr_info.bt_name);
			printk("Broadcast Name: %s\n", sr_info.broadcast_name);
			printk("Broadcast ID: 0x%06x\n\n", sr_info.broadcast_id);
			
			// Stop scanning, no data more is needed
			err = bt_le_scan_stop();
			if (err != 0) {
				printk("bt_le_scan_stop failed with %d\n", err);
			}

			printk("Selecting Broadcast ID: 0x%06x\n", sr_info.broadcast_id);

			// Store the data
			selected_broadcast_id = sr_info.broadcast_id;
			selected_sid = info->sid;
			selected_pa_interval = info->interval;
			bt_addr_le_copy(&selected_addr, info->addr);

			// Hand-off to main function
			k_sem_give(&sem_source_discovered);
		}

	} else { // Not already scanning for source
		// Scan for and connect to Broadcast Sink

		// Only interested in connectable advertisers
		// Sink doesn't advertise interval/periodic train
		if ((info->adv_props & BT_GAP_ADV_PROP_CONNECTABLE) == 0) {
			return;
		}

		// Walk and parse the advertisment, and sr_info stores
		bt_data_parse(ad, device_found, (void *)&sr_info);

		// Check: BASS is found
		if (sr_info.has_bass) {
			printk("Broadcast Sink Found:\n");
			printk("BT Name: %s\n", sr_info.bt_name);

			// Once a sink is remembered, only reconnect to that one
			if (sink_link_has_sink() && !sink_link_matches(info->addr)) {
				printk("Not the remembered sink, ignoring\n\n");
				return;
			}

			// Stop scanning, no data more is needed
			err = bt_le_scan_stop();
			if (err != 0) {
				printk("bt_le_scan_stop failed with %d\n", err);
			}

			printk("Connecting to Broadcast Sink: %s\n", sr_info.bt_name);

			// Who to connect to, creation params, connection interval + latency, write conn handle
			err = bt_conn_le_create(info->addr, BT_CONN_LE_CREATE_CONN, BT_BAP_CONN_PARAM_RELAXED, &broadcast_sink_conn);
			
			// Check: failure, restart scanning
			if (err != 0) {
				printk("Failed creating connection (err=%u)\n", err);
				return;
			}
		}
	}
}

/**
 * Fires when a scan ends - duration expired.
 */ 
static void scan_timeout_cb(void)
{
	printk("Scan timeout\n");
}

/**
 * vtable - struct of function pointers.
 */ 
static struct bt_le_scan_cb scan_callbacks = {
	.recv = scan_recv_cb,
	.timeout = scan_timeout_cb,
};

/**
 * Scans for a broadcast source matching the requested stop.
 * 
 * @return 0 if one was found
 */
static int scan_for_broadcast_source(void)
{
	int err;

	// Set flag
	scanning_for_broadcast_source = true;

	// Start scanning
	err = bt_le_scan_start(BT_LE_SCAN_PASSIVE, NULL);
	if (err) {
		printk("Scanning failed to start (err %d)\n", err);
		return err;
	}

	printk("Scanning for Broadcast Source successfully started\n");

	// Block thread until scan_recv_cb gives semaphore
	// 10s scanning timeout
	err = k_sem_take(&sem_source_discovered, SEM_TIMEOUT);
	if (err != 0) {
		printk("No matching source found within the timeout\n");
		(void)bt_le_scan_stop();
	}

	return err;
}

/**
 * Scanning for a broadcast sink.
 */
static void scan_for_broadcast_sink(void)
{
	int err;

	// Set flag for source to false, cannot do at same time
	scanning_for_broadcast_source = false;

	// Start scanning
	err = bt_le_scan_start(BT_LE_SCAN_PASSIVE, NULL);
	if (err) {
		printk("Scanning failed to start (err %d)\n", err);
		return;
	}

	printk("Scanning for Broadcast Sink successfully started\n");
}

/**
 * Fires when connection attempt finishes.
 * Could be successful/unsuccessful.
 * 
 * @param conn Bluetooth connection
 * @param err error passed
 */
static void connected(struct bt_conn *conn, uint8_t err)
{
	// CB fires for every connection the stack handles
	if (conn != broadcast_sink_conn) {
		return;
	}

	// Check: failure path
	if (err != 0) {
		printk("Failed to connect to %s %u %s\n", bt_conn_dst_str(conn), err, bt_hci_err_to_str(err));

		bt_conn_unref(broadcast_sink_conn);
		broadcast_sink_conn = NULL;

		return;
	}

	// Success, set connected semaphore
	printk("Connected: %s\n", bt_conn_dst_str(conn));

	// Set sink once connected
	if (!sink_link_has_sink()) {
		sink_link_set(bt_conn_get_dst(conn));
	}

	k_sem_give(&sem_sink_connected);
}

/**
 * Fires when established connection drops.
 * 
 * @param conn Bluetooth connection
 * @param reason HCI reason code
 */
static void disconnected(struct bt_conn *conn, uint8_t reason)
{
	// Check: sink is connected
	if (conn != broadcast_sink_conn) {
		return;
	}

	// Set state
	gatt_link_set_state(GATT_LINK_NO_SINK);

	printk("Disconnected: %s, reason 0x%02x %s\n", bt_conn_dst_str(conn), reason, bt_hci_err_to_str(reason));

	// Release reference and clear handle
	bt_conn_unref(broadcast_sink_conn);
	broadcast_sink_conn = NULL;

	// Wake whoever is waiting
	k_sem_give(&sem_sink_disconnected);
}

/**
 * Fires when security level is changed.
 * 
 * @param conn Bluetooth connection
 * @param level security level
 * @param err security error
 */
static void security_changed_cb(struct bt_conn *conn, bt_security_t level, enum bt_security_err err)
{
	// Success, security level changed
	if (err == 0) {
		printk("Security level changed: %u\n", level);
		k_sem_give(&sem_security_updated);
	} else { // Failure
		printk("Failed to set security level: %s(%u)\n", bt_security_err_to_str(err), err);
	}
}

/**
 * When bt_bap_broadcast_assistant_discover finishes walking
 * sink's BASS service. 
 * 
 * @param conn Bluetooth connection
 * @param err error
 * @param recv_state_count how many states the sink handles
 */
static void bap_broadcast_assistant_discover_cb(struct bt_conn *conn, int err, uint8_t recv_state_count)
{
	if (err == 0) {
		printk("BASS discover done with %u recv states\n", recv_state_count);
		remote_recv_state_count = recv_state_count;
		k_sem_give(&sem_bass_discovered);
	} else {
		printk("BASS discover failed (%d)\n", err);
	}
}

/**
 * Reads the sink's receive state directly.
 *
 * The JM320 does not reliably notify after a source swap, so asking is
 * the only way to learn whether the new source actually took. A read is
 * mandatory in BASS where notifications are optional.
 */
static void recv_state_poll_handler(struct k_work *work)
{
	int err;

	if (broadcast_sink_conn == NULL) {
		return;
	}

	printk("Polling the sink's receive state\n");

	err = bt_bap_broadcast_assistant_read_recv_state(broadcast_sink_conn, 0);
	if (err != 0) {
		printk("Polled read failed (%d)\n", err);
	}
}

static K_WORK_DELAYABLE_DEFINE(recv_state_poll, recv_state_poll_handler);

/**
 * When bt_bap_broadcast_assistant_add_src adds a source
 * via sink's BASS service. 
 * 
 * @param conn Bluetooth connection
 * @param err error
 */
static void bap_broadcast_assistant_add_src_cb(struct bt_conn *conn, int err)
{
	if (err != 0) {
		gatt_link_set_state(GATT_LINK_FAILED);
		printk("BASS add source failed (%d)\n", err);
		return;
	}

	printk("BASS add source successful\n");

	/* Scheduled rather than called directly: a GATT read cannot be
	 * issued from inside a GATT callback.
	 */
	k_work_schedule(&recv_state_poll, K_SECONDS(2));
}
/**
 * Adding a source via sink's BASS service. 
 * 
 * @param conn Bluetooth connection
 * @param err error
 */
static void bap_broadcast_assistant_rem_src_cb(struct bt_conn *conn, int err)
{
	if (err == 0) {
		current_src_id = 0;
		printk("BASS remove source successful\n");
	} else {
		printk("BASS remove source failed (%d)\n", err);
	}

	k_sem_give(&sem_source_removed);
}

/**
 * Tells whether anything actually worked.
 * 
 * Fires via read_recv_states() and when sink tells you.
 * 
 * @param conn Bluetooth connection
 * @param err error
 * @param state 
 */
static void bap_broadcast_assistant_recv_state_read_cb(struct bt_conn *conn, int err, const struct bt_bap_scan_delegator_recv_state *state)
{
	// Check: error
	if (err != 0) {
		printk("BASS recv state read failed (%d)\n", err);
		return;
	}

	// State table is non-empty, can connect to sink
	if (state != NULL) {
		// Set source's ID
		if (expecting_src_id) {
			current_src_id = state->src_id;
			expecting_src_id = false;
		}
		
		// Sink asks for code when synced to periodic advertising
		if (state->encrypt_state == BT_BAP_BIG_ENC_STATE_BCODE_REQ) {
			printk("Broadcast code required, supplying it\n");
			bt_bap_broadcast_assistant_set_broadcast_code(conn, state->src_id, broadcast_code);
		}

		printk("BASS recv state: src_id %u, addr %s, sid %u, sync_state %u, encrypt_state "
		       "%u, num_subgroups %u\n", state->src_id, bt_addr_le_str(&state->addr),
		       state->adv_sid, state->pa_sync_state, state->encrypt_state,
		       state->num_subgroups);

		bool receiving = false;

		for (uint8_t i = 0; i < state->num_subgroups; i++) {
			const struct bt_bap_bass_subgroup *subgroup = &state->subgroups[i];

			printk("\t[%d]: BIS sync %u, metadata_len %u\n", i, subgroup->bis_sync, subgroup->metadata_len);
		
			if (subgroup->bis_sync != 0) {
				receiving = true;
			}
		}

		if (receiving) {
			gatt_link_set_state(GATT_LINK_RECEIVING);
		} else if (state->pa_sync_state == 3) {
			gatt_link_set_state(GATT_LINK_FAILED);
		} else {
			gatt_link_set_state(GATT_LINK_CONNECTING);
		}
	}

	k_sem_give(&sem_recv_state_read);
}

/** 
 * Callback struct/vtable 
 * 
 * Struct of function pointers - . holds address of function, not result
 * .field = value sets named members and leaves the rest zero
 */
static struct bt_bap_broadcast_assistant_cb ba_cbs = {
	.discover = bap_broadcast_assistant_discover_cb,
	.add_src = bap_broadcast_assistant_add_src_cb,
	.rem_src = bap_broadcast_assistant_rem_src_cb,
	.recv_state = bap_broadcast_assistant_recv_state_read_cb,
};

/**
 * Reset application state for next attempt
 */ 
static void reset(void)
{
	int err;

	printk("\n\nResetting...\n\n");

	if (broadcast_sink_conn != NULL) {
		err = bt_conn_disconnect(broadcast_sink_conn, BT_HCI_ERR_LOCALHOST_TERM_CONN);

		if (err != 0) {
			printk("bt_conn_disconnect failed with %d\n", err);
		} else {
			if (k_sem_take(&sem_sink_disconnected, SEM_TIMEOUT) != 0) {
				printk("Timed out waiting for disconnect\n");
			}
		}
	}

	/* Ignore return value as scanning may already be stopped */
	(void)bt_le_scan_stop();

	selected_broadcast_id = BT_BAP_INVALID_BROADCAST_ID;
	selected_sid = 0;
	selected_pa_interval = 0;
	(void)memset(&selected_addr, 0, sizeof(selected_addr));

	// Clear source
	current_src_id = 0;
	expecting_src_id = false;

	k_sem_reset(&sem_source_discovered);
	k_sem_reset(&sem_sink_connected);
	k_sem_reset(&sem_sink_disconnected);
	k_sem_reset(&sem_security_updated);
	k_sem_reset(&sem_bass_discovered);
	k_sem_reset(&sem_recv_state_read);
	k_sem_reset(&sem_source_removed);
}

BT_CONN_CB_DEFINE(conn_callbacks) = {
	.connected = connected,
	.disconnected = disconnected,
	.security_changed = security_changed_cb
};

/**
 * Read all found receive states - some or all may be empty
 */
static int read_recv_states(void)
{
	for (uint8_t i = 0U; i < remote_recv_state_count; i++) {
		int err;

		err = bt_bap_broadcast_assistant_read_recv_state(broadcast_sink_conn, i);

		if (err != 0) {
			printk("Failed to read receive state[%u]: %d\n", i, err);

			return err;
		}

		err = k_sem_take(&sem_recv_state_read, SEM_TIMEOUT);
		if (err != 0) {
			printk("Failed to take sem_recv_state_read: %d\n", err);

			return err;
		}
	}

	return 0;
}

static void remove_current_source(void)
{
	if (broadcast_sink_conn == NULL || current_src_id == 0) {
		return;
	}

	int err;

	printk("Removing source %u\n", current_src_id);

	err = bt_bap_broadcast_assistant_rem_src(broadcast_sink_conn, current_src_id);
	if (err != 0) {
		current_src_id = 0;
		printk("Failed to remove source (err %d)\n", err);
		return;
	}

	err = k_sem_take(&sem_source_removed, SEM_TIMEOUT);
	if (err != 0) {
		current_src_id = 0;
		printk("Timed out removing source\n");
	}
}

/**
 * Connects to the sink and discovers its BASS service.
 *
 * @return 0 when the sink is ready to accept sources
 */
static int connect_to_sink(void)
{
	int err;

	scan_for_broadcast_sink();

	err = k_sem_take(&sem_sink_connected, SEM_TIMEOUT);
	if (err != 0) {
		printk("Failed to take sem_sink_connected (err %d)\n", err);
		return err;
	}

	err = bt_bap_broadcast_assistant_discover(broadcast_sink_conn);
	if (err != 0) {
		printk("Failed to discover BASS on the sink (err %d)\n", err);
		return err;
	}

	/* 
	 * BASS needs encrypted link, and discovery triggers the
	 * security upgrade, so security completes before discovery does.
	 */
	err = k_sem_take(&sem_security_updated, SEM_TIMEOUT);
	if (err != 0) {
		printk("Failed to take sem_security_updated (err %d)\n", err);
		return err;
	}

	err = k_sem_take(&sem_bass_discovered, SEM_TIMEOUT);
	if (err != 0) {
		printk("Failed to take sem_bass_discovered (err %d)\n", err);
		return err;
	}

	return read_recv_states();
}

/**
 * Scans for the requested stop's transmitter and tells the sink to join it.
 *
 * @return 0 if Add Source was sent
 */
static int join_requested_stop(void)
{
	if (broadcast_sink_conn == NULL) {
		return -ENOTCONN;
	}

	struct bt_bap_broadcast_assistant_add_src_param param = {0};
	struct bt_bap_bass_subgroup subgroup = {0};
	int err;

	gatt_link_set_state(GATT_LINK_SCANNING);

	err = scan_for_broadcast_source();
	if (err != 0) {
		gatt_link_set_state(GATT_LINK_FAILED);
		return err;
	}

	printk("Selected source: id 0x%06X, sid %u, interval %u, addr %s\n",
	       selected_broadcast_id, selected_sid, selected_pa_interval,
	       bt_addr_le_str(&selected_addr));

	/* 
	 * Sink syncs to the periodic advertising itself (pa_sync = true)
	 * and picks its own BIS, so the BASE never needs reading here.
	 */
	param.addr = selected_addr;
	param.adv_sid = selected_sid;
	param.broadcast_id = selected_broadcast_id;
	param.pa_interval = selected_pa_interval;
	param.pa_sync = true;

	subgroup.bis_sync = BT_BAP_BIS_SYNC_NO_PREF;
	subgroup.metadata_len = 0;

	param.num_subgroups = 1;
	param.subgroups = &subgroup;
	
	printk("Adding source to the sink\n");

	err = bt_bap_broadcast_assistant_add_src(broadcast_sink_conn, &param);
	if (err != 0) {
		printk("Failed to add source (err %d)\n", err);
		gatt_link_set_state(GATT_LINK_FAILED);
		return err;
	}

	expecting_src_id = true;
	gatt_link_set_state(GATT_LINK_CONNECTING);
	return 0;
}

/**
 * Main driver
 */
int main(void)
{
	int err;

	// Start Bluetooth stack
	err = bt_enable(NULL);
	if (err) {
		printk("Bluetooth init failed (err %d)\n", err);
		return 0;
	}

	// Load config
	if (IS_ENABLED(CONFIG_SETTINGS)) {
		settings_load();
	}
	
	// Enable GATT server
	err = gatt_link_init();
	if (err != 0) {
		printk("Failed to start the phone link (err %d)\n", err);
	}

	// Set IDLE state
	gatt_link_set_state(GATT_LINK_IDLE);

	printk("Sink ready, waiting for a stop request\n");
	printk("Bluetooth initialized\n");

	// Registers the two callback structs with Zephyr
	bt_bap_broadcast_assistant_register_cb(&ba_cbs);
	bt_le_scan_cb_register(&scan_callbacks);

	memcpy(broadcast_code, BROADCAST_CODE, sizeof(BROADCAST_CODE) - 1);

	while (true) {
		reset();

		if (connect_to_sink() != 0) {
			continue;
		}

		gatt_link_set_state(GATT_LINK_IDLE);

		/* 
		 * Journey loop - exits when the sink drops.
		 * Outer loop reconnects.
		 */
		while (broadcast_sink_conn != NULL) {
			uint8_t stop;

			if (gatt_link_wait_for_command(K_SECONDS(2)) != 0) {
				// Re-check the sink
				continue;
			}

			gatt_link_drain_commands();

			/* 
			 * The sink holds one receive state, so the old source
			 * must go before the new one can be added.
			 */
			remove_current_source();

			stop = gatt_link_get_requested_stop_index();

			if (stop == 0) {
				printk("Journey ended\n");
				gatt_link_set_state(GATT_LINK_IDLE);
				continue;
			}

			printk("Joining stop %u\n", stop);
			(void)join_requested_stop();
		}

		printk("Sink connection lost, reconnecting\n");
	}

	return 0;
}
```

## src/gatt_link.c
```c
#include <zephyr/autoconf.h>
#include <zephyr/bluetooth/bluetooth.h>
#include <zephyr/bluetooth/gatt.h>
#include <zephyr/bluetooth/uuid.h>
#include <zephyr/sys/printk.h>
#include <zephyr/sys/util.h>

#include "gatt_link.h"

/**
 * Comes in from Auracast companion over GATT.
 * 0 = nothing requested - stop listening.
 */
static uint8_t requested_stop_index = 1;

// Phone has notifications on?
static bool notifications_enabled;

// Storing current state
static enum gatt_link_state current_state = GATT_LINK_IDLE;

static K_SEM_DEFINE(sem_command_received, 0, 1);

/**
 * Names for the GATT DB, which is a flat list
 * of attributes.
 */
// Name of the group - shows up on the app when it scans
static const struct bt_uuid_128 service_uuid = BT_UUID_INIT_128(BT_UUID_128_ENCODE(0x6c618b36, 0x1ac6, 0x4e8a, 0x9797, 0x6db150ca9c5f));
// Name of characteristics the phone writes to
static const struct bt_uuid_128 command_uuid = BT_UUID_INIT_128(BT_UUID_128_ENCODE(0x09162189, 0xa913, 0x415d, 0x9d9a, 0x681c6d450517));
// Names state that the board notifies to
static const struct bt_uuid_128 status_uuid = BT_UUID_INIT_128(BT_UUID_128_ENCODE(0x4d35a4c2, 0x464b, 0x4e22, 0xb21d, 0xc9f904c3d094));

/**
 * Advertising payload. Broadcasted continuously to everyone unprompted.
 * Device name and flags.
 * 
 * Initialized array of bt_data: discoverable, LE only, no classic Bluetooth.
 * const = puts it in flash, not ram; static = file-local, live the whole program.
 */
static const struct bt_data ad[] = {
	BT_DATA_BYTES(BT_DATA_FLAGS, (BT_LE_AD_GENERAL | BT_LE_AD_NO_BREDR)),
	BT_DATA(BT_DATA_NAME_COMPLETE, CONFIG_BT_DEVICE_NAME, sizeof(CONFIG_BT_DEVICE_NAME) - 1),
};

/**
 * Advertising payload. Is the scan response - active scanner can send a scan
 * request after hearing an advertisment, device replies with second payload.
 * Initialized array of bt_data: discoverable, LE only, no classic Bluetooth.
 * const = puts it in flash, not ram; static = file-local, live the whole program.
 */
static const struct bt_data sd[] = {
    BT_DATA_BYTES(BT_DATA_UUID128_ALL, BT_UUID_128_ENCODE(0x6c618b36, 0x1ac6, 0x4e8a, 0x9797, 0x6db150ca9c5f))
};

/**
 * Handles every GATT write to the command characteristic. Validates write, 
 * stores the byte, scan_recv_cb reads it when deciding the correct transmitter.
 *
 * @return bytes consumed
 */
static ssize_t write_command(struct bt_conn *conn, const struct bt_gatt_attr *attr, const void *buf, uint16_t len, uint16_t offset, uint8_t flags)
{
	const uint8_t *value = buf;

	// Long writes not supported
	if (offset != 0) {
		return BT_GATT_ERR(BT_ATT_ERR_INVALID_OFFSET);
	}

	if (len != sizeof(uint8_t)) {
		return BT_GATT_ERR(BT_ATT_ERR_INVALID_ATTRIBUTE_LEN);
	}

    // Get the stop index
	requested_stop_index = value[0];

    // Check: if stop listening
	if (requested_stop_index == 0) {
		printk("Phone requested: stop listening\n");
	} else {
		printk("Phone requested: stop %u\n", requested_stop_index);
	}

	// Command received, unblock thread
	k_sem_give(&sem_command_received);

	return len;
}

/**
 * Called when the phone subscribes to or unsubscribes from status
 * notifications.
 */
static void status_changed(const struct bt_gatt_attr *attr, uint16_t value)
{
	notifications_enabled = (value == BT_GATT_CCC_NOTIFY);
	printk("Status notifications %s\n", notifications_enabled ? "enabled" : "disabled");
}

/**
 * Builds attribute table, registers it with GATT server at startup.
 */
BT_GATT_SERVICE_DEFINE(auracast_svc,
	BT_GATT_PRIMARY_SERVICE(&service_uuid),

	BT_GATT_CHARACTERISTIC(&command_uuid.uuid,
			       BT_GATT_CHRC_WRITE,
			       BT_GATT_PERM_WRITE,
			       NULL, write_command, NULL),

	BT_GATT_CHARACTERISTIC(&status_uuid.uuid,
			       BT_GATT_CHRC_NOTIFY,
			       BT_GATT_PERM_NONE,
			       NULL, NULL, NULL),

	BT_GATT_CCC(status_changed,
		    BT_GATT_PERM_READ | BT_GATT_PERM_WRITE),
);

void gatt_link_drain_commands(void)
{
	k_sem_reset(&sem_command_received);
}

int gatt_link_wait_for_command(k_timeout_t timeout)
{
	return k_sem_take(&sem_command_received, timeout);
}

static void gatt_link_notify_state(enum gatt_link_state state)
{
	if (!notifications_enabled) {
		return;
	}

	uint8_t value = (uint8_t)state;

	/** 
	 * Attribute 4 is the status characteristic's value, counting from
	 * the service declaration at index 0.
	 */
	int err = bt_gatt_notify(NULL, &auracast_svc.attrs[4], &value, sizeof(value));

	// Logging failure
	if (err != 0) {
		printk("Notify failed (err %d)\n", err);
	}
}

void gatt_link_set_state(enum gatt_link_state state)
{
	if (state == current_state) {
		return;
	}

	current_state = state;
	printk("State: %u\n", (unsigned)state);
	gatt_link_notify_state(state);
}

uint8_t gatt_link_get_requested_stop_index(void)
{
	return requested_stop_index;
}


int gatt_link_init(void) 
{
    int err;
    
    // Start advertising
    err = bt_le_adv_start(BT_LE_ADV_CONN_FAST_1, ad, ARRAY_SIZE(ad), sd, ARRAY_SIZE(sd));
    if (err != 0) {
        printk("Advertising failed to start (err %d)\n", err);
        return err;
    }

    printk("Advertising as \"%s\"\n", CONFIG_BT_DEVICE_NAME);
    return 0;
}
```

## src/gatt_link.h
```c
#pragma once
#include <stdint.h>

#include <zephyr/kernel.h>

// GATT state enum
enum gatt_link_state {
	GATT_LINK_IDLE, // Nothing requested
	GATT_LINK_SCANNING, // Looking for stop's transmitter
	GATT_LINK_CONNECTING, // Add Source sent, waiting for sink sync
	GATT_LINK_RECEIVING, // Sink reports bis_sync non-zero, audio flowing
	GATT_LINK_NO_SINK, // Not connected to sink
	GATT_LINK_FAILED // Scan time out/sync failure
};

/**
 * Starts advertising so the companion app can find and connect to the board.
 *
 * @return 0 on success
 */
int gatt_link_init(void);

/**
 * The stop index the phone has asked for. Not unspecified args.
 *
 * @return stop index, or 0 if nothing has been requested
 */
uint8_t gatt_link_get_requested_stop_index(void);

/**
 * Setter for notification state
 */
void gatt_link_set_state(enum gatt_link_state state);

/**
 * Blocks until the phone writes a stop request.
 *
 * @param timeout how long to wait, or K_FOREVER
 * @return 0 if a command arrived
 */
int gatt_link_wait_for_command(k_timeout_t timeout);

/**
 * Discard any commands that arrived while the board was busy handling
 * the previous one.
 */
void gatt_link_drain_commands(void);
```

## src/metadata.c
```c
#include <zephyr/sys/byteorder.h>

#include "metadata.h"

bool metadata_parse(const uint8_t *data, size_t len, struct metadata *out)
{
    // Check: length of the incoming payload
    if (len < METADATA_MIN_LEN) {
        return false;
    }

    // Check: Magic of the payload - special identifier in the periodic advertisement
    if (data[0] != METADATA_MAGIC_0 || data[1] != METADATA_MAGIC_1) {
        return false;
    }

    // Check protocol version
    if (data[2] != METADATA_VERSION) {
        return false;
    }

    // All checks passed, write into metadata 
    out->protocol_version = data[2];
    out->route_id = sys_get_le16(&data[3]); // Both 3 & 4 little endian bytes
    out->stop_index = data[5];
    out->direction = data[6];
    out->language = data[7];

    return true;
}
```

## src/metadata.h
```c
#pragma once
#include <stdint.h>
#include <stddef.h> 
#include <stdbool.h>

// Metadata definitions
#define METADATA_MAGIC_0 0x41 // "A"
#define METADATA_MAGIC_1 0x55 // "U"
#define METADATA_VERSION 1
#define METADATA_MIN_LEN 8
#define METADATA_COMPANY_ID 0xFFFF

// Metadata header - receiving from Broadcast Source
struct metadata
{
    uint8_t protocol_version;
    uint16_t route_id;
    uint8_t stop_index;
    uint8_t direction;
    uint8_t language;
};

/**
 * Parses the metadata received from the source's
 * extended advertisement train. 
 * 
 * @param data non-modification pointer to first byte of payload - determines Magic 
 * @param len how many bytes data points at
 * @param out storing the result - parsing sucess + parsed fields
 * 
 * @return whether the parsing succeeded
 */
bool metadata_parse(const uint8_t *data, size_t len, struct metadata *out);
```

## src/sink_link.c
```c
#include <string.h>
#include <errno.h>

#include <zephyr/bluetooth/addr.h>
#include <zephyr/settings/settings.h>
#include <zephyr/sys/printk.h>

#include "sink_link.h"

#define SINK_SETTINGS_KEY "auracast/sink"

static bt_addr_le_t stored_addr;
static bool have_stored_addr;

bool sink_link_has_sink(void)
{
	return have_stored_addr;
}

bool sink_link_matches(const bt_addr_le_t *addr)
{
	// Check: does the sink link have an already stored address
	if (!have_stored_addr) {
		return false;
	}

	// Compare the two addresses
	if (bt_addr_le_cmp(&stored_addr, addr) == 0) {
		return true;
	} else {
		return false;
	}
}

void sink_link_set(const bt_addr_le_t *addr)
{
	int err;

	// Create a copy of the incoming address
	bt_addr_le_copy(&stored_addr, addr);
	have_stored_addr = true;

	// Store the new address
	err = settings_save_one(SINK_SETTINGS_KEY, &stored_addr, sizeof(stored_addr));
	if (err != 0) {
		printk("Failed to save sink address (err %d)\n", err);
		return;
	}

	printk("Remembered sink %s\n", bt_addr_le_str(&stored_addr));
}

/**
 * Called by settings during settings_load() for each key.
 */
static int sink_settings_set(const char *name, size_t len, settings_read_cb read_cb, void *cb_arg)
{
	ssize_t bytes;

	if (!settings_name_steq(name, "sink", NULL)) {
		return -ENOENT;
	}

	if (len != sizeof(stored_addr)) {
		return -EINVAL;
	}

	bytes = read_cb(cb_arg, &stored_addr, sizeof(stored_addr));
	if (bytes < 0) {
		return bytes;
	}

	have_stored_addr = true;
	printk("Loaded sink %s\n", bt_addr_le_str(&stored_addr));

	return 0;
}

SETTINGS_STATIC_HANDLER_DEFINE(auracast_sink, "auracast", NULL, sink_settings_set, NULL, NULL);
```

## src/sink_link.h
```c
#pragma once

#include <stdbool.h>

#include <zephyr/bluetooth/addr.h>

/**
 * Whether a sink has been remembered from a previous run.
 */
bool sink_link_has_sink(void);

/**
 * Whether the given address is the remembered sink.
 */
bool sink_link_matches(const bt_addr_le_t *addr);

/**
 * Remembers this address as the rider's sink, persisting it to flash.
 */
void sink_link_set(const bt_addr_le_t *addr);
```
